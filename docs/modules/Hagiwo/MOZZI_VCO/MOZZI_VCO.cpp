//https://note.com/solder_state/n/n71c67b5aaeca

#include <MozziGuts.h>
#include <Oscil.h> // oscillator template
//#include <OverSample.h>

#include <tables/saw2048_int8.h> // saw table for oscillator
#include <tables/square_no_alias512_int8.h> // saw table for oscillator
#include <tables/triangle_hermes_2048_int8.h> // saw table for oscillator
#include <tables/sin2048_int8.h> // sine table for oscillator
#include <tables/whitenoise8192_int8.h> // noise table for oscillator

Oscil <SAW2048_NUM_CELLS, AUDIO_RATE> aSaw1(SAW2048_DATA);
Oscil <SAW2048_NUM_CELLS, AUDIO_RATE> aSaw2(SAW2048_DATA);

Oscil <SQUARE_NO_ALIAS512_NUM_CELLS, AUDIO_RATE> aSqu1(SQUARE_NO_ALIAS512_DATA);
Oscil <SQUARE_NO_ALIAS512_NUM_CELLS, AUDIO_RATE> aSqu2(SQUARE_NO_ALIAS512_DATA);

Oscil <TRIANGLE_HERMES_2048_NUM_CELLS, AUDIO_RATE> aTri1(TRIANGLE_HERMES_2048_DATA);
Oscil <TRIANGLE_HERMES_2048_NUM_CELLS, AUDIO_RATE> aTri2(TRIANGLE_HERMES_2048_DATA);

Oscil <SIN2048_NUM_CELLS, AUDIO_RATE> aSin1(SIN2048_DATA);
Oscil <SIN2048_NUM_CELLS, AUDIO_RATE> aSin2(SIN2048_DATA);

Oscil <WHITENOISE8192_NUM_CELLS, AUDIO_RATE> aNis1(WHITENOISE8192_DATA);
Oscil <WHITENOISE8192_NUM_CELLS, AUDIO_RATE> aNis2(WHITENOISE8192_DATA);
#define CONTROL_RATE 128 // Hz, powers of 2 are most reliable


int freq1 = 440;//base freq of OSC1
int freq2 = 220;//base freq of OSC2
int voct = 1000;//external V/OCT LSB
int freqv1 = 440;// freq1 apply voct
int freqv2 = 220;// freq2 apply voct
char octsw = 0;//1=-1oct,2=0oct,4=1oct
int wave_knob = 0;//AD wave knob
char wave = 0;//0_saw,1_squ,2_tri,3_sin,4_noise
byte gain = 127;

//const static float voctpow[4096] PROGMEM = {
//  0,  0.00122,  0.002441, 0.003662, 0.004882, 0.006103, 0.007324, 0.008544, 0.009765, 0.010986, 0.012207, 0.013427, 0.014648,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 4.998779
//};

const static float voctpow[1024] PROGMEM = {
 0,  0.004882, 0.009765, 0.014648, 0.019531, 0.024414, 0.029296, 0.034179, 0.039062, 0.043945, 0.048828, 0.05371,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 4.995117
};

const static byte gain_table[2][128]PROGMEM = {
 {127,  127,  127,  127,  127,  127,  127,  127,  127,  127,  127,  127,  127,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  118,  127},
 {127,  124,  121,  118,  115,  112,  109,  106,  103,  100,  97, 94, 91,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  127,  127}
};

void setup()
{
 //  Serial.begin(9600);
 pinMode(2, INPUT_PULLUP);
 pinMode(3, INPUT_PULLUP);
 startMozzi(CONTROL_RATE); // :)
}


void updateControl() {

 //select waveform
 wave_knob = mozziAnalogRead(3);
 if (wave_knob <= 174) {
   wave = 0;
 }
 else if (wave_knob > 174 && wave_knob <= 408) {
   wave = 1;
 }
 else if (wave_knob > 408 && wave_knob <= 612) {
   wave = 2;
 }
 else if (wave_knob > 612 && wave_knob <= 866) {
   wave = 3;
 }
 else if (wave_knob > 866 ) {
   wave = 4;
 }

 //output amp rate
 gain = mozziAnalogRead(4) / 8;

 //OCT toggle SW
 if (digitalRead(3) == 1 && digitalRead(2) == 1) {
   octsw = 2;
 }
 else if (digitalRead(3) == 0 && digitalRead(2) == 1) {
   octsw = 4;
 }
 else {
   octsw = 1;
 }

 //OSC frequency knob
 freq1 = mozziAnalogRead(0) / 4 ;
 freq2 = mozziAnalogRead(1) / 4 ;
 if (abs(freq1 - freq2) <= 1 * octsw) {
   freq2 = freq1;
 }
 else  if (abs(freq1 * 2 - freq2) <= 1 * octsw) {
   freq2 = freq1 * 2;
 }
 else  if (abs(freq1 - freq2 * 2) <= 1 * octsw) {
   freq2 = freq1 / 2;
 }

 //frequency setting
 voct = mozziAnalogRead(7) ;
 //    voct = overSampler.next(voct)*2; //if need more resolution 
 freqv1 = freq1 * pow(2, (pgm_read_float(&(voctpow[voct])))) * octsw; // V/oct apply
 freqv2 = freq2 * pow(2, (pgm_read_float(&(voctpow[voct])))) * octsw; // V/oct apply


 switch (wave) {
   case 0:
     aSaw1.setFreq(freqv1); // set the frequency
     aSaw2.setFreq(freqv2); // set the frequency
     break;

   case 1:
     aSqu1.setFreq(freqv1); // set the frequency
     aSqu2.setFreq(freqv2); // set the frequency
     break;

   case 2:
     aTri1.setFreq(freqv1); // set the frequency
     aTri2.setFreq(freqv2); // set the frequency
     break;

   case 3:
     aSin1.setFreq(freqv1); // set the frequency
     aSin2.setFreq(freqv2); // set the frequency
     break;

   case 4:
     aNis1.setFreq(freqv1); // set the frequency
     aNis2.setFreq(freqv2); // set the frequency
     break;
 }

 //For development
 //  Serial.print(gain);
 //  Serial.print(",");
 //  Serial.print(mozziAnalogRead(4));
 //  Serial.println("");
}

int updateAudio() {
 switch (wave) {
   case 0:
     return MonoOutput::from8Bit(aSaw1.next() * (pgm_read_byte(&(gain_table[0][gain]))) / 256 + aSaw2.next() * (pgm_read_byte(&(gain_table[1][gain]))) / 256);
     break;

   case 1:
     return MonoOutput::from8Bit(aSqu1.next() * (pgm_read_byte(&(gain_table[0][gain]))) / 256 + aSqu2.next() * (pgm_read_byte(&(gain_table[1][gain]))) / 256);
     break;

   case 2:
     return MonoOutput::from8Bit(aTri1.next() * (pgm_read_byte(&(gain_table[0][gain]))) / 256 + aTri2.next() * (pgm_read_byte(&(gain_table[1][gain]))) / 256);
     break;

   case 3:
     return MonoOutput::from8Bit(aSin1.next() * (pgm_read_byte(&(gain_table[0][gain]))) / 256 + aSin2.next() * (pgm_read_byte(&(gain_table[1][gain]))) / 256);
     break;

   case 4:
     return MonoOutput::from8Bit(aNis1.next() * (pgm_read_byte(&(gain_table[0][gain]))) / 256 + aNis2.next() * (pgm_read_byte(&(gain_table[1][gain]))) / 256);
     break;
 }

}


void loop() {
 audioHook(); // required here
}